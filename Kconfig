## Kconfig
```kconfig
mainmenu "RT-Thread Configuration"

config $BSP_DIR
    string
    option env="BSP_ROOT"
    default "."

config $RTT_DIR
    string
    option env="RTT_ROOT"
    default "E:/rt-thread"

# you can change the RTT_ROOT default "../.." to your rtthread_root,
# example : default "F:/git_repositories/rt-thread"

config $PKGS_DIR
    string
    option env="PKGS_ROOT"
    default "packages"


config RT_NAME_MAX
    int
    default 16
config RT_USING_DFS
    bool
    default y
config RT_USING_POSIX
    bool
    default n
config DFS_FILESYSTEMS_MAX
    int
    default 8
config DFS_FILESYSTEM_TYPES_MAX
    int
    default 8
config DFS_FD_MAX
    int
    default 32
config RT_USING_DFS_ELMFAT
    bool
    default y
config RT_USING_DFS_ROMFS
    bool
    default y
config RT_USING_DFS_DEVFS
    bool
    default y
config RT_USING_DFS_NET
    bool
    default n
config FINSH_USING_MSH_ONLY
    bool
    default y
config RT_TICK_PER_SECOND
    int
    default 1000
config RT_USING_INTERRUPT_INFO
    bool
    default y
config RT_SERIAL_RB_BUFSZ
    int
    default 4096
config RT_USING_SERIAL
    bool
    default y
config RT_USING_PIN
    bool
    default y
config RT_USING_I2C
    bool
    default y
config RT_USING_SFUD
    bool
    default y
config RT_USING_RTC
    bool
    default y
config RT_USING_WDT
    bool
    default y
config RT_USING_LWIP
    bool
    default n
config RT_LWIP_RAW
    bool
    default y
config RT_MEMP_NUM_NETCONN
    int
    default 16
config RT_LWIP_NETIF_LOOPBACK
    bool
    default y
config LWIP_DHCP_CHECK_LINK_UP
    int
    default 1
    
source "$RTT_DIR/KConfig"
source "$PKGS_DIR/KConfig"
    
menu "Bsp definition options"
    config RT_USING_SDIO
        bool "Using SDIO device drivers"
        default n
    config RT_USING_SPI
        bool "Using SPI device drivers"
        default n
    config RT_USING_PWM
        bool "Using PWM device drivers"
        default n
    config RT_USING_LCD
        bool "Using LCD device drivers"
        default n
    config PKG_USING_LITTLEVGL2RTT
        bool "Using Littlevgl2RTT"
        default n
    if PKG_USING_LITTLEVGL2RTT
        config LV_MEM_CUSTOM 
            int
            default 1
        config LV_COLOR_DEPTH 
            int "color depth"
            default 16
        config LV_HOR_RES 
            int "horizontal pixels"
            default 800 
        config LV_VER_RES 
            int "vertical pixels"
            default 480 
        config LV_DPI 
            int "DPI(dot per inch)"
            default 50 
        config LITTLEVGL2RTT_USING_DEMO
            bool
            default y
    endif
    choice
        prompt "Dynamic Memory Management"
        default RT_USING_SLAB
        config RT_USING_NOHEAP
            bool "Disable Heap"
        config RT_USING_SMALL_MEM
            bool "Small Memory Algorithm"
        config RT_USING_SLAB
            bool "SLAB Algorithm for large memory"
        if RT_USING_MEMHEAP
        config RT_USING_MEMHEAP_AS_HEAP
            bool "Use all of memheap objects as heap"
        endif
    endchoice
    choice
        prompt "Support long file name"
        default RT_DFS_ELM_USE_LFN_3
        config RT_DFS_ELM_USE_LFN_0
            bool "0: LFN disable"
        config RT_DFS_ELM_USE_LFN_1
            bool "1: LFN with static LFN working buffer"
        config RT_DFS_ELM_USE_LFN_2
            bool "2: LFN with dynamic LFN working buffer on the stack"
        config RT_DFS_ELM_USE_LFN_3
            bool "3: LFN with dynamic LFN working buffer on the heap"
    endchoice
    choice
        prompt "lwIP version"
        default RT_USING_LWIP202
        config RT_USING_LWIP141
            bool "lwIP v1.4.1"
        config RT_USING_LWIP202
            bool "lwIP v2.0.2"
    endchoice
    menu "Static IPv4 Address"
        config RT_LWIP_IPADDR
            string "IPv4: IP address"
            default 192.168.100.30
        config RT_LWIP_GWADDR
            string "IPv4: Gateway address"
            default 192.168.100.1
        config RT_LWIP_MSKADDR
            string "IPv4: Mask address"
            default 255.255.255.0
    endmenu
endmenu
```
